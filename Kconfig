## Kconfig
```kconfig
config NICKEY_PAW3222
    bool "Nickey44A PAW3222 with CS tied to ground"
    depends on GPIO && INPUT
    default y if DT_HAS_NICKEY_PAW3222_2WIRE_ENABLED
    help
      GPIO two-wire transport for the PAW3222. SDIO is released during reads.
```

## dts/bindings/input/pixart,paw3222-2wire.yaml
```yaml
description: PAW3222 with bidirectional SDIO and CS permanently tied to ground
compatible: "pixart,paw3222-2wire"
include: base.yaml
properties:
  sclk-gpios:
    type: phandle-array
    required: true
  sdio-gpios:
    type: phandle-array
    required: true
  motion-gpios:
    type: phandle-array
    required: true
    description: Active-low MOTION output
  res-cpi:
    type: int
    default: 1216
    description: Resolution from 608 to 4826 CPI, in steps of 38
```

## modules/zmk-input-processor-touch-inertia/dts/bindings/input/processor/input-processor-touch-inertia.yaml
```yaml
description: Touch-release inertia for a relative wheel axis
compatible: "zmk,input-processor-touch-inertia"
include: ip_zero_param.yaml
properties:
  release-timeout-ms:
    type: int
    default: 100
    description: Maximum age of the last nonzero wheel sample at release; older motion cannot launch inertia.
  cancel-scroll-inertia-on-ctrl:
    type: boolean
    description: Suppress scroll inertia while either Ctrl modifier is active.
  wheel-code:
    type: int
    required: true
  touch-code:
    type: int
    required: true
  tick-ms:
    type: int
    default: 10
    description: Tick interval in milliseconds; zero is treated as one.
  decay-permille:
    type: int
    default: 920
    description: Velocity retention per tick, from 0 through 999.
  stop-threshold-q8:
    type: int
    default: 96
    description: Inertia stops below this positive Q8 velocity in wheel units per tick.
  launch-threshold-q8:
    type: int
    default: 384
    description: Minimum Q8 velocity required to start inertia on touch release.
  ema-new-permille:
    type: int
    default: 250
    description: New sample weight, from 0 through 1000.
```

## modules/zmk-input-processor-touch-swipe/dts/bindings/input/processor/input-processor-touch-swipe.yaml
```yaml
description: One horizontal swipe per complete touch, with configurable ZMK keycodes
compatible: "zmk,input-processor-touch-swipe"
include: ip_zero_param.yaml
properties:
  pair-slot:
    type: int
    default: -1
    description: Shared two-pad gesture slot (0 or 1); -1 disables pairing.
  pair-direction:
    type: int
    default: 1
    description: Sign of the outward horizontal axis after transforms; -1 or 1.
  pair-window-ms:
    type: int
    default: 250
    description: Time to wait for the other outward swipe; both instances must match.
  pair-keycode:
    type: int
    default: 0
    description: Encoded keycode for a paired outward swipe; both instances must match.
  hwheel-code:
    type: int
    required: true
  wheel-code:
    type: int
    required: true
  touch-code:
    type: int
    required: true
  threshold:
    type: int
    default: 8
    description: Positive minimum net horizontal wheel units.
  axis-ratio:
    type: int
    default: 2
    description: Positive horizontal magnitude to total vertical travel ratio.
  left-keycode:
    type: int
    required: true
    description: Encoded ZMK keycode tapped on a negative horizontal swipe.
  right-keycode:
    type: int
    required: true
    description: Encoded ZMK keycode tapped on a positive horizontal swipe.
  override-layer:
    type: int
    default: -1
    description: Layer ID selecting alternate keycodes at swipe recognition; -1 disables.
  override-left-keycode:
    type: int
    default: 0
    description: Encoded keycode for a negative swipe when override-layer is active.
  override-right-keycode:
    type: int
    default: 0
    description: Encoded keycode for a positive swipe when override-layer is active.
```
